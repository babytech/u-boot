## configs/vexpress_ca9x4_defconfig
```kconfig
CONFIG_ARM=y
CONFIG_TARGET_VEXPRESS_CA9X4=y
CONFIG_SYS_TEXT_BASE=0x60800000
CONFIG_DISTRO_DEFAULTS=y
CONFIG_NR_DRAM_BANKS=2
CONFIG_BOOTCOMMAND="setenv bootargs 'root=/dev/mmcblk0 rw console=ttyAMA0 init=/linuxrc'; ext2load mmc 0:0 0x60100000 /boot/uImage; ext2load mmc 0:0 0x60600000 /boot/vexpress-v2p-ca9.dtb; bootm 0x60100000 - 0x60600000"
CONFIG_CONSOLE_LOGBUFFER=y
CONFIG_CONSOLE_LOGBUFFER_ADDR=0x7c001000
CONFIG_CONSOLE_LOGBUFFER_SIZE=0x4000
CONFIG_LOGLEVEL=7
# CONFIG_DISPLAY_CPUINFO is not set
# CONFIG_DISPLAY_BOARDINFO is not set
# CONFIG_CMD_CONSOLE is not set
# CONFIG_CMD_BOOTD is not set
# CONFIG_CMD_XIMG is not set
# CONFIG_CMD_EDITENV is not set
# CONFIG_CMD_LOADB is not set
# CONFIG_CMD_LOADS is not set
CONFIG_CMD_MMC=y
# CONFIG_CMD_ITEST is not set
# CONFIG_CMD_SETEXPR is not set
# CONFIG_CMD_NFS is not set
# CONFIG_CMD_MISC is not set
CONFIG_ENV_IS_IN_FLASH=y
CONFIG_MTD_NOR_FLASH=y
CONFIG_SMC911X=y
CONFIG_SMC911X_BASE=0x4e000000
CONFIG_SMC911X_32_BIT=y
CONFIG_BAUDRATE=38400
CONFIG_CONS_INDEX=0
CONFIG_OF_LIBFDT=y
```
